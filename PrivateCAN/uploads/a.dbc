VERSION ""

NS_ :

BS_:

BU_:

BO_ 3221225472 VECTOR__INDEPENDENT_SIG_MSG: 0 Vector__XXX
 SG_ TheSecondSignal : 0|8@1- (1,0) [0|0] "" Vector__XXX

BO_ 1 ItWorkedTest2: 8 Vector__XXX

BO_ 0 ItWorked: 1 Vector__XXX
 SG_ TheSignal1 : 0|8@1- (1,0) [0|0] "" Vector__XXX

CM_ BO_ 3221225472 "This is a message for not used signals, created by Vector CANdb++ DBC OLE DB Provider.";
BA_DEF_  "BusType" STRING ;
BA_DEF_DEF_  "BusType" "CAN";
